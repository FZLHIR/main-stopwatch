## components/Hard_Start/Kconfig
```kconfig
# Kconfig file for Hard_Start component

menu "Hard_Start"

    config HARDS_START_ENABLE
        bool "Enable Hard_Start"
        default y

    if HARDS_START_ENABLE
        menu  "i80_PIN"
        config lcd_cs
            int "LCD CS"
            default 46
        config lcd_rs
            int "LCD RS"
            default 9
        config lcd_wr
            int "LCD WR"
            default 10
        config lcd_rst
            int "LCD RST"
            default 3
        config lcd_bl
            int "LCD BL"
            default 0
        config lcd_d0
            int "LCD D0"
            default 11
        config lcd_d1
            int "LCD D1"
            default 12
        config lcd_d2
            int "LCD D2"
            default 13
        config lcd_d3
            int "LCD D3"
            default 14
        config lcd_d4
            int "LCD D4"
            default 21
        config lcd_d5
            int "LCD D5"
            default 47
        config lcd_d6
            int "LCD D6"
            default 48
        config lcd_d7
            int "LCD D7"
            default 45
        config lcd_clock
            int "LCD Clock"
            default 2
            help
                时钟速度，单位MHz，默认2MHz
        help
            T6K71屏幕的硬件引脚配置
        endmenu
    
        menu "GPS_PIN"
        config GPS_PPS
            int "GPS PPS"
            default 2
        config GPS_RX
            int "GPS RX"
            default 43
        config GPS_TX
            int "GPS TX"
            default 44
        config GPS_SLP
            int "GPS SLP"
            default 1        
        config GPS_BAUD
            int "GPS Baud"
            default 9600
            help
                GPS模块波特率，默认9600
        help
            GPS模块的硬件引脚配置    
        endmenu
                
        menu "MPU6050_PIN"
        config MPU6050_SCL
            int "MPU6050 SCL"
            default 22
        config MPU6050_SDA
            int "MPU6050 SDA"
            default 21
        config MPU6050_INT
            int "MPU6050 INT"
            default 23
        help
            MPU6050模块的硬件引脚配置 
            注意在板子上，ALCC与INT相连，即电量计lc2944完全复用6050引脚   
        endmenu
    
        menu "SD_PIN"
            choice SD_MODE
                prompt "选择SD模式"
                default SD_MODE_SDIO 
                help
                    SD卡模式选择，默认SDIO模式
    
                config SD_MODE_SPI
                    bool "SPI模式"
                config SD_MODE_SDIO
                    bool "SDIO模式"
            endchoice
    
            if SD_MODE_SPI
                config SD_CS
                    int "SD CS"
                    default 5
                config SD_MOSI
                    int "SD MOSI"
                    default 6
                config SD_SCLK
                    int "SD SCLK"
                    default 7
                config SD_MISO
                    int "SD MISO"
                    default 17
            endif
    
            if SD_MODE_SDIO        
                config SD_D3
                    int "SD D3"
                    default 5
                config SD_CMD
                    int "SD CMD"
                    default 6
                config SD_CLK
                    int "SD CLK"
                    default 7
                config SD_D0
                    int "SD D0"
                    default 17
                config SD_D1
                    int "SD D1"
                    default 18
                config SD_D2
                    int "SD D2"
                    default 4 
            endif
    
                config SD_insertion
                    int "SD Insertion"
                    default 8
                    help
                        SD卡插入检测引脚，低电平表示卡插入
                
        help
            SD卡模块的硬件引脚配置    
        endmenu
        
        menu "ENCODER_PIN"
            config ENCODER_A
                int "ENCODER A"
                default 41
            config ENCODER_S
                int "ENCODER S"
                default 40
            config ENCODER_B
                int "ENCODER B"
                default 42
        help
            编码器模块的硬件引脚配置    
        endmenu

    endif
endmenu
```
